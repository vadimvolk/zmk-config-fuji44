## config/boards/shields/fuji44/Kconfig.defconfig
```kconfig
if SHIELD_FUJI44_LEFT

config ZMK_KEYBOARD_NAME
    default "Fuji44"

config ZMK_SPLIT_ROLE_CENTRAL
    default y

endif

if SHIELD_FUJI44_LEFT || SHIELD_FUJI44_RIGHT

config ZMK_SPLIT
    default y

endif
```

## config/boards/shields/fuji44/Kconfig.shield
```kconfig
# Copyright (c) 2020 Pete Johanson
# SPDX-License-Identifier: MIT

config SHIELD_FUJI44_LEFT
    def_bool $(shields_list_contains,fuji44_left)

config SHIELD_FUJI44_RIGHT
    def_bool $(shields_list_contains,fuji44_right)
```
